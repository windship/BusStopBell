// --- OLED 화면출력용 라이브러리 ----------------------------------------------------- 
#include "U8glib.h"
#include <avr/pgmspace.h>
// -----------------------------------------------------------------------------

// --- SD카드용 라이브러리 -----------------------------------------------------------
#include <SD.h>
// -----------------------------------------------------------------------------

// --- WAV 파일 재생용 라이브러리 -----------------------------------------------------
#include <TMRpcm.h>
#include <SPI.h>
// -----------------------------------------------------------------------------

#define BTN1_PIN 3 // 버튼1 입력에 사용할 핀을 3로 설정. 아두이노 나노의 경우 RX, TX 핀은 쓰지말자.
#define BTN2_PIN 2 // 버튼2 입력에 사용할 핀을 2로 설정
#define LED_PIN 4 // LED에 사용할 핀을 4로 설정
#define SD_ChipSelectPin 10  // SD 카드와의 통신에 사용할 핀을 10으로 설정

// --- 한글 선택항목용 bmp 데이터 ------------------------------------------------

const unsigned char IMG_D1[] PROGMEM = {
0x00,0x00,0x00,0x00,0x00,0x00,0x00,0x00,0x00,0x00,0x00,
0x00,0x06,0x60,0x00,0x00,0x00,0x60,0x00,0x00,0x3f,0x00,
0x07,0xf6,0x61,0xff,0x86,0x18,0x60,0x18,0x00,0xe1,0xc0,
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0x00,0x00,0x00,0x00,0x00,0x00,0x00,0x00,0x00,0x00,0x00
}; 

const unsigned char IMG_D2[] PROGMEM = {
0x00,0x00,0x00,0x00,0x00,0x00,0x00,0x00,0x00,0x00,0x00,
0x00,0x06,0x60,0x00,0x00,0x00,0x60,0x00,0x00,0x3f,0x00,
0x07,0xf6,0x61,0xff,0x86,0x18,0x60,0x18,0x00,0xe1,0xc0,
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0x00,0x00,0x00,0x00,0x00,0x00,0x00,0x00,0x00,0x00,0x00
}; 

const unsigned char IMG_D3[] PROGMEM = {
0x00,0x00,0x00,0x00,0x00,0x00,0x00,0x00,0x00,0x00,0x00,
0x00,0x06,0x60,0x00,0x00,0x00,0x60,0x00,0x00,0x3f,0x00,
0x07,0xf6,0x61,0xff,0x86,0x18,0x60,0x18,0x00,0xe1,0xc0,
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0x00,0x00,0x00,0x00,0x00,0x00,0x00,0x00,0x00,0x00,0x00
}; 

const unsigned char IMG_H1[] PROGMEM = {
0x00,0x00,0x00,0x00,0x00,0x00,0x00,0x00,0x00,0x00,0x00,
0x00,0xc0,0x60,0x06,0x60,0x00,0x60,0x00,0x00,0x3f,0x00,
0x07,0xf8,0x67,0xf6,0x66,0x18,0x60,0x18,0x00,0xe1,0xc0,
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0x00,0x00,0x00,0x00,0x00,0x00,0x00,0x00,0x00,0x00,0x00
}; 

const unsigned char IMG_H2[] PROGMEM = {
0x00,0x00,0x00,0x00,0x00,0x00,0x00,0x00,0x00,0x00,0x00,
0x00,0xc0,0x60,0x06,0x60,0x00,0x60,0x00,0x00,0x3f,0x00,
0x07,0xf8,0x67,0xf6,0x66,0x18,0x60,0x18,0x00,0xe1,0xc0,
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0x00,0x00,0x00,0x00,0x00,0x00,0x00,0x00,0x00,0x00,0x00
}; 

const unsigned char IMG_A[] PROGMEM = {
0x00,0x00,0x00,0x00,0x00,0x00,0x00,0x00,0x00,0x00,0x00,
0x00,0xc1,0x80,0xc1,0x86,0x0c,0xc0,0x18,0x00,0x3c,0x40,
0x00,0xc1,0x80,0xc1,0x86,0x0c,0xc0,0x18,0x00,0x24,0x20,
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0x00,0x00,0x00,0x00,0x00,0x00,0x00,0x00,0x00,0x00,0x00
}; 

// --------------------------------------------------------------------------------------------------

String current; // 문자열 변수 current 선언
int currentNum = 0; // 현재 선택항목 값
int fileCountOnSD = 0; // SD 카드의 파일 갯수 세는 변수

File root;

TMRpcm tmrpcm; // TMRpcm 사용 설정

U8GLIB_SSD1306_128X32 u8g(U8G_I2C_OPT_NONE); // u8glib 사용 선언

// --------------------------------------------------------------------------------------------------


void setup() 
{
  current.reserve(16); // 문자열 current를 위한 메모리 버퍼 확정. 이건 setup() 안에서 해야한다!

  pinMode(BTN1_PIN, INPUT_PULLUP); // 버튼 1의 입력을 풀업저항으로 설정하여 플로팅을 없앤다
  pinMode(BTN2_PIN, INPUT_PULLUP); // 버튼 2의 입력을 풀업저항으로 설정하여 플로팅을 없앤다
  pinMode(LED_PIN, OUTPUT); 
  Serial.begin(9600);

  if (!SD.begin(SD_ChipSelectPin)) {  // see if the card is present and can be initialized:
    Serial.println("SD fail");  
    return;   // don't do anything more if not
  }
  else{   
    Serial.println("SD ok");   
  }

  tmrpcm.speakerPin = 9; // 스피커용 핀 설정
  tmrpcm.volume(2);

  root = SD.open("/");

  fileCount(root, 0);

  Serial.print(F("fileCountOnSD: "));
  Serial.println(fileCountOnSD);

  u8g.firstPage(); // 그냥 drawChar()만 하면 안되고 이 퍼스트, 넥스트 페이지를 꼭 같이 써줘야 하는듯
  do 
  {
    current = (F("HYUNDA~1"));
    u8g.drawBitmapP (1, 16, 11, 15, IMG_H1);     
  } while( u8g.nextPage() );

}

void loop() 
{
  int push1= digitalRead(BTN1_PIN); // 버튼 1이 눌리는가?
  int push2 = digitalRead(BTN2_PIN); // 버튼 2가 눌리는가?

  if(push1 == 0) // 버튼 1이 눌렸다면 change() 함수 실행 (선택된 파일명 변경)
  {
    Serial.println(F("Change!"));
    change();
  }

  if(push2 == 0) // 버튼 2가 눌렸다면 stopSound() 함수 실행 (wav 파일 재생)
  {
    Serial.println(F("Sound!"));
    stopSound();
  }

  if(tmrpcm.isPlaying() == 0)
  {
    tmrpcm.disable(); 
    digitalWrite(LED_PIN, LOW);
  }
}

void fileCount(File dir, int numTabs) // SD카드에 있는 파일 갯수를 알아낸다
{
  while (true) 
  {
    File entry =  dir.openNextFile();
    if (! entry) {
      // no more files
      break;
    }

    // for each file count it
    fileCountOnSD++;

    entry.close();
  }
}

void drawChar(void) // OLED 액정에 문자 출력하는 함수
{
  // 전체 화면을 다시 그리는 그래픽 명령은 반드시 여기에 넣을 것
  u8g.setFont(u8g_font_9x18B);
  u8g.setPrintPos(0, 20); 
  // 베이스 클래스에서 프로시저 호출 http://arduino.cc/en/Serial/Print
  //u8g.print(current); // 현재 선택된 항목 current 값을 텍스트로 OLED에 표시
}

void change() // 버튼 입력으로 현재 선택된 사운드를 변경함
{
  if(currentNum == 5)
  {
    currentNum = 0;
  }
  else
  {
    currentNum++;
  }

  u8g.firstPage();
  do
  {
  switch (currentNum) // 버튼 누를 때마다 바뀐 값에 따라 문자열을 변경한다
  {
    case 0:
      current = (F("HYUNDA~1"));
      u8g.drawBitmapP (1, 16, 11, 15, IMG_H1); 
      break;
    case 1:
      current = (F("HYUNDA~2"));
      u8g.drawBitmapP (1, 16, 11, 15, IMG_H2); 
      break;
    case 2:
      current = (F("DAEWOO_1"));
      u8g.drawBitmapP (1, 16, 11, 15, IMG_D1); 
      break;
    case 3:
      current = (F("DAEWOO_2"));
      u8g.drawBitmapP (1, 16, 11, 15, IMG_D2); 
      break;
    case 4:
      current = (F("DAEWOO_3"));
      u8g.drawBitmapP (1, 16, 11, 15, IMG_D3); 
      break;
    case 5:
      current = (F("ANNOUNCE"));
      u8g.drawBitmapP (1, 16, 11, 15, IMG_A); 
      break;
  }
  }
  while(u8g.nextPage());
  
  Serial.println(current);
  delay(200);
}

void stopSound() // 파일명 current.wav 파일을 재생
{
  String currentFile = current + ".wav";
    
  // --- String currentFile을 char* 타입으로 변경함 -----------------------------------------
  char currentFileName[40]={0};
  currentFile.toCharArray(currentFileName,currentFile.length()+1); // 끝에 +1 안해주면 확장자 끝 한글자가 짤림
  // ----------------------------------------------------------------------------------------
  
  Serial.println(currentFileName);
  digitalWrite(LED_PIN, HIGH);
  tmrpcm.play(currentFileName); // 파일 재생
  delay(1000);
}
